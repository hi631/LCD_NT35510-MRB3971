// MRB3971.cpp 
//
#include <Arduino.h>
#include "MRB3971.h"

_lcd_dev lcddev;
uint16_t BACK_COLOR, POINT_COLOR;

MRB3971::MRB3971(uint8_t cs, uint8_t rs, uint8_t rd, uint8_t wr, uint8_t rst, uint8_t PARALLEL_0, uint8_t pin) {
  _cs = cs; pinMode(_cs, OUTPUT);  digitalWrite(_cs, HIGH); _csbit = ((uint32_t)1 << _cs);
  _rs = rs; pinMode(_rs, OUTPUT);  digitalWrite(_rs, HIGH); _rsbit = ((uint32_t)1 << _rs);
  _rd = rd; pinMode(_rd, OUTPUT);  digitalWrite(_rd, HIGH); _rdbit = ((uint32_t)1 << _rd);
  _wr = wr; pinMode(_wr, OUTPUT);  digitalWrite(_wr, HIGH); _wrbit = ((uint32_t)1 << _wr);
  _rst = rst; pinMode(_rst, OUTPUT);  digitalWrite(_rst, HIGH); _rstbit = ((uint32_t)1 << _rst);
  _PARALLEL_0 = PARALLEL_0;  parallel_setup();
  //Init();
  _pin = pin;  pinMode(_pin, OUTPUT);
}

void MRB3971::ledon() { digitalWrite(_pin, HIGH);}
void MRB3971::ledoff() { digitalWrite(_pin, LOW);}

void MRB3971::parallel_setup(void) { for (int i = 0; i < 8; i++) { pinMode(_PARALLEL_0 + i, INPUT); }}
void MRB3971::set_inputs(void) { REG_WRITE(GPIO_ENABLE_W1TC_REG, 0xFF << _PARALLEL_0);}
void MRB3971::set_outputs(void) { REG_WRITE(GPIO_ENABLE_W1TS_REG, 0xFF << _PARALLEL_0);}
uint8_t MRB3971::parallel_read(void) {
  uint32_t input = REG_READ(GPIO_IN_REG);  return (input >> _PARALLEL_0);
}
void MRB3971::parallel_write(uint8_t value) {
  uint32_t output = (REG_READ(GPIO_OUT_REG) & ~(0xFF << _PARALLEL_0)) | (((uint32_t)value) << _PARALLEL_0);
  REG_WRITE(GPIO_OUT_REG, output);
}

void MRB3971::writex2(uint8_t HVAL,uint8_t LVAL){
  set_outputs();
  GPIO.out_w1tc = _csbit;
  parallel_write(HVAL); GPIO.out_w1tc = _wrbit; GPIO.out_w1ts = _wrbit;
  parallel_write(LVAL); GPIO.out_w1tc = _wrbit; GPIO.out_w1ts = _wrbit;
  GPIO.out_w1ts = _csbit;
}

void MRB3971::WR_REG(uint16_t Reg){ 
  GPIO.out_w1tc = _rsbit;
  writex2((Reg>>8) & 0xFF, Reg&0xFF);
} 

void MRB3971::WR_DATA(uint16_t Data){
  GPIO.out_w1ts = _rsbit;
  writex2((Data>>8) & 0xFF, Data & 0xFF);
}

void MRB3971::WriteReg(uint16_t LCD_Reg, uint16_t LCD_RegValue){
  WR_REG(LCD_Reg);
  WR_DATA(LCD_RegValue);
}

uint16_t MRB3971::RD_DATA(void){
  uint16_t rd;
  GPIO.out_w1ts = _rsbit;
  set_inputs() ;
  GPIO.out_w1tc = _csbit;  GPIO.out_w1tc = _rdbit;
  ets_delay_us(1);  rd =  parallel_read();
  GPIO.out_w1ts = _rdbit;  GPIO.out_w1ts = _csbit;
  return rd;
}

void MRB3971::ReadReg(uint16_t LCD_Reg,uint16_t *Rval,int n){
  WR_REG(LCD_Reg);
  while(n--){ 
  #ifdef LCD_8BIT 
    *(Rval++) = (RD_DATA()<<8)|RD_DATA();
  #else 
    *(Rval++) = RD__DATA();
  #endif
  }
}

void MRB3971::WriteRAM_Prepare(void){
   WR_REG(lcddev.wramcmd);   
}

void MRB3971::FillWindow(uint16_t Color){
  int i;
  uint8_t colh,coll;
  //SetWindow(0,0,lcddev.w-1,lcddev.h-1);
  GPIO.out_w1tc = _csbit;
  GPIO.out_w1ts = _rsbit;
  colh = (Color>>8) & 0xFF; coll = Color & 0xFF; 
  uint32_t outbuf = (REG_READ(GPIO_OUT_REG) & ~(0xFF << _PARALLEL_0));
  //
  for(i=0;i<lcddev.w*lcddev.h;i++){
#ifdef LCD_8BIT 
    REG_WRITE(GPIO_OUT_REG, outbuf | ((uint32_t)colh) << _PARALLEL_0);
    GPIO.out_w1tc = _wrbit; GPIO.out_w1ts = _wrbit;
    REG_WRITE(GPIO_OUT_REG, outbuf | ((uint32_t)coll) << _PARALLEL_0);
    GPIO.out_w1tc = _wrbit; GPIO.out_w1ts = _wrbit;
#else
                                // LCD_DataPortH = (Color>>8)&0xFF;
    parallel_write(Color&0xFF); // LCD_DataPortL = Color&0xFF;
    GPIO.out_w1tc = _wrbit; GPIO.out_w1ts = _wrbit;
#endif   
  }
  GPIO.out_w1ts = _csbit;
}

void MRB3971::Reset(void){
  delay(50); digitalWrite( _rst, LOW); 
  delay(50); digitalWrite( _rst, HIGH); 
  delay(50);
}

void MRB3971::SetWindow(uint16_t xStar, uint16_t yStar,uint16_t xEnd,uint16_t yEnd){  
  WriteReg(lcddev.setxcmd,xStar>>8);  WriteReg(lcddev.setxcmd+1,xStar&0XFF);   
  WriteReg(lcddev.setxcmd+2,xEnd>>8); WriteReg(lcddev.setxcmd+3,xEnd&0XFF);   
  WriteReg(lcddev.setycmd,yStar>>8);  WriteReg(lcddev.setycmd+1,yStar&0XFF);  
  WriteReg(lcddev.setycmd+2,yEnd>>8); WriteReg(lcddev.setycmd+3,yEnd&0XFF); 
  WriteRAM_Prepare();        
}   

void MRB3971::direction(uint8_t direction){ 
  lcddev.setxcmd=0x2A00;  lcddev.setycmd=0x2B00;
  lcddev.wramcmd=0x2C00;  lcddev.rramcmd=0x2E00;
  switch(direction){      
    case 0: lcddev.w=LCD_W; lcddev.h=LCD_H; WriteReg(0x3600,0x00); break;
    case 1: lcddev.w=LCD_H; lcddev.h=LCD_W; WriteReg(0x3600,(1<<5)|(1<<6)); break;
    case 2: lcddev.w=LCD_W; lcddev.h=LCD_H; WriteReg(0x3600,(1<<7)|(1<<6)); break;
    case 3: lcddev.w=LCD_H; lcddev.h=LCD_W; WriteReg(0x3600,(1<<7)|(1<<5)); break;  
    default:break;
  } 
}  

uint16_t MRB3971::Read_ID(void){
  uint16_t val,valt;
  uint8_t iniID[] = {0x55,0xAA,0x52,0x08,0x01}; WriteRegM( 0xF000, sizeof(iniID), iniID);
  ReadReg(0x0c00,&valt,1);  ReadReg(0x0d00,&val,1);  val |= (valt <<= 8);
  return val;
}

void MRB3971::WriteRegM( uint16_t adr, uint16_t len, uint8_t dat[]){
  for(int i=0; i<len; i++) WriteReg( adr++, dat[i]);
}

void MRB3971::Init(void){
  Reset();
  //************* NT35510**********//  
  uint8_t ini01[] = {0x55,0xAA,0x52,0x08,0x01}; WriteRegM( 0xF000, sizeof(ini01), ini01);
  uint8_t ini03[] = {0x34, 0x34, 0x34}; WriteRegM( 0xB600, sizeof(ini03), ini03);
  uint8_t ini02[] = {0x0D, 0x0D, 0x0D}; WriteRegM( 0xB000, sizeof(ini02), ini02); // AVDD Set AVDD 5.2V
  uint8_t ini05[] = {0x34, 0x34, 0x34}; WriteRegM( 0xB700, sizeof(ini05), ini05); // AVEE ratio
  uint8_t ini04[] = {0x0D, 0x0D, 0x0D}; WriteRegM( 0xB100, sizeof(ini04), ini04); // AVEE  -5.2V
  uint8_t ini07[] = {0x24, 0x24, 0x24}; WriteRegM( 0xB800, sizeof(ini07), ini07); // VCL ratio
  uint8_t ini10[] = {0x34, 0x34, 0x34}; WriteRegM( 0xB900, sizeof(ini10), ini10); // VGH  ratio
  uint8_t ini09[] = {0x0F, 0x0F, 0x0F}; WriteRegM( 0xB300, sizeof(ini09), ini09);
  uint8_t ini14[] = {0x24, 0x24, 0x24}; WriteRegM( 0xBA00, sizeof(ini14), ini14); // VGLX  ratio
  uint8_t ini12[] = {0x08, 0x08}; WriteRegM( 0xB500, sizeof(ini12), ini12);
  uint8_t ini15[] = {0x00, 0x78, 0x00}; WriteRegM( 0xBC00, sizeof(ini15), ini15); // VGMP/VGSP 4.5V/0V
  uint8_t ini16[] = {0x00, 0x78, 0x00}; WriteRegM( 0xBD00, sizeof(ini16), ini16); // VGMN/VGSN -4.5V/0V
  uint8_t ini17[] = {0x00, 0x89}; WriteRegM( 0xBE00, sizeof(ini17), ini17);  // VCOM  -1.325V
  // Gamma Setting   
  uint8_t ini20[] = {
    0x00, 0x2D, 0x00, 0x2E, 0x00, 0x32, 0x00, 0x44, 0x00, 0x53, 0x00, 0x88, 0x00, 0xB6, 0x00, 0xF3, 0x01, 0x22, 0x01, 0x64,
    0x01, 0x92, 0x01, 0xD4, 0x02, 0x07, 0x02, 0x08, 0x02, 0x34, 0x02, 0x5F, 0x02, 0x78, 0x02, 0x94, 0x02, 0xA6, 0x02, 0xBB,
    0x02, 0xCA, 0x02, 0xDB, 0x02, 0xE8, 0x02, 0xF9, 0x03, 0x1F, 0x03, 0x7F }; 
  WriteRegM( 0xD100, sizeof(ini20), ini20); WriteRegM( 0xD400, sizeof(ini20), ini20); // R+ R-
  WriteRegM( 0xD200, sizeof(ini20), ini20); WriteRegM( 0xD500, sizeof(ini20), ini20); // G+ G-
  WriteRegM( 0xD300, sizeof(ini20), ini20); WriteRegM( 0xD600, sizeof(ini20), ini20); // B+ B-
  //
  uint8_t ini21[] = {0x55,0xAA,0x52,0x08,0x00}; WriteRegM( 0xF000, sizeof(ini21), ini21); //#Enable Page0
  uint8_t ini22[] = {0x08,0x05,0x02,0x05,0x02}; WriteRegM( 0xB000, sizeof(ini22), ini22);  //# RGB I/F Setting
  WriteReg(0xB600,0x08); WriteReg(0xB500,0x50);  //## SDT: //0x6b ?? 480x854  0x50 ?? 480x800
  uint8_t ini24[] = {0x00,0x00}; WriteRegM( 0xB700, sizeof(ini24), ini24); //## Gate EQ:
  uint8_t ini25[] = {0x01,0x05,0x05,0x05}; WriteRegM( 0xB800, sizeof(ini25), ini25); //## Source EQ:
  uint8_t ini26[] = {0x00,0x00,0x00}; WriteRegM( 0xBC00, sizeof(ini26), ini26); //# Inversion: Column inversion (NVT)
  uint8_t ini27[] = {0x03,0x00,0x00}; WriteRegM( 0xCC00, sizeof(ini27), ini27); //# BOE's Setting(default)
  uint8_t ini28[] = {0x01,0x84,0x07,0x31,0x00,0x01}; WriteRegM( 0xBD00, sizeof(ini28), ini28); //# Display Timing:
  //
  uint8_t ini30[] = {0xAA,0x55,0x25,0x01}; WriteRegM( 0xFF00, sizeof(ini30), ini30);
  WriteReg(0x3500,0x00); WriteReg(0x3600,0x00); WriteReg(0x3a00,0x55);  //0x55=16bit Mode
  WR_REG(0x1100); delay(120); WR_REG(0x2900); delay(120); WR_REG(0x2c00);
}

PROGMEM const unsigned char asc2_1608[1520]={
0x00,0x00,0x00,0x00,0x00,0x00,0x00,0x00,0x00,0x00,0x00,0x00,0x00,0x00,0x00,0x00,0x00,0x00,0x00,0x08,0x08,0x08,0x08,0x08,0x08,0x08,0x00,0x00,0x18,0x18,0x00,0x00,
0x00,0x48,0x6C,0x24,0x12,0x00,0x00,0x00,0x00,0x00,0x00,0x00,0x00,0x00,0x00,0x00,0x00,0x00,0x00,0x24,0x24,0x24,0x7F,0x12,0x12,0x12,0x7F,0x12,0x12,0x12,0x00,0x00,
0x00,0x00,0x08,0x1C,0x2A,0x2A,0x0A,0x0C,0x18,0x28,0x28,0x2A,0x2A,0x1C,0x08,0x08,0x00,0x00,0x00,0x22,0x25,0x15,0x15,0x15,0x2A,0x58,0x54,0x54,0x54,0x22,0x00,0x00,
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0x0C,0x32,0xC2,0x00,0x00,0x00,0x00,0x00,0x00,0x00,0x00,0x00,0x00,0x00,0x00,0x00,
}; 

void MRB3971::DrawPoint(uint16_t x,uint16_t y){
  if(x<lcddev.w-1 && y<lcddev.h-1 ){
    SetWindow(x,y,x,y); WR_DATA(POINT_COLOR);
  }
}
uint16_t MRB3971::ReadPoint(uint16_t x,uint16_t y){
  uint16_t color;
  if(x>=lcddev.w || y>=lcddev.h) return 0;  
  SetWindow(x,y,x,y);     // LCD_SetCursor(x,y); 
  WR_REG(lcddev.rramcmd); // LCD_ReadRAM_Prepare();

  uint16_t d,r,g,b;
  set_inputs() ; GPIO.out_w1ts = _rsbit; GPIO.out_w1tc = _csbit;
  //d = RD_DATA(); r = RD_DATA(); g = RD_DATA(); b = RD_DATA();
  GPIO.out_w1tc = _rdbit; ets_delay_us(1); d = REG_READ(GPIO_IN_REG) >> _PARALLEL_0; GPIO.out_w1ts = _rdbit; // Dumy
  GPIO.out_w1tc = _rdbit; ets_delay_us(1); r = REG_READ(GPIO_IN_REG) >> _PARALLEL_0; GPIO.out_w1ts = _rdbit;
  GPIO.out_w1tc = _rdbit; ets_delay_us(1); g = REG_READ(GPIO_IN_REG) >> _PARALLEL_0; GPIO.out_w1ts = _rdbit;
  GPIO.out_w1tc = _rdbit; ets_delay_us(1); b = REG_READ(GPIO_IN_REG) >> _PARALLEL_0; GPIO.out_w1ts = _rdbit;
  GPIO.out_w1ts = _csbit;

  color = ((r & 0xF8) << 8) | ((g & 0xFC) << 3) | ((b & 0xF8) >> 3); // Color_To_565
  return color;
}    
    
void MRB3971::ShowChar(uint16_t x,uint16_t y,uint8_t num,uint8_t mode){
  uint8_t temp, pos,t;
  uint16_t x0=x;
  uint16_t colortemp=POINT_COLOR;      
  if(x>=lcddev.w || y>=lcddev.h) return;     
  num=num-' '; SetWindow(x,y,x+8-1,y+16-1);
  if(!mode){
    for(pos=0;pos<16;pos++){ 
      temp=pgm_read_byte(asc2_1608+(uint16_t)num*16+pos);
      for(t=0;t<8;t++){                 
        if(temp&0x01) POINT_COLOR=colortemp;
        else          POINT_COLOR=BACK_COLOR;
        WR_DATA(POINT_COLOR);
        temp>>=1; x++;
      }
      x=x0; y++;
    }
  } else {
    for(pos=0;pos<16;pos++) {
      temp=pgm_read_byte(asc2_1608+(uint16_t)num*16+pos);
      for(t=0;t<8;t++) {                 
        if(temp&0x01) DrawPoint(x+t,y+pos);
        temp>>=1; 
      }
    }
  }
  POINT_COLOR=colortemp;                
}   
void MRB3971::ShowString(uint16_t x,uint16_t y,uint8_t *p){         
    while(*p!='\0') {       
        if(x>lcddev.w-16){x=0;y+=16;}
        if(y>lcddev.h-16) {y=x=0;}
        ShowChar(x,y,*p,0); x+=8; p++;
    }  
}

void MRB3971::Fill(uint16_t x1, uint16_t y1, uint16_t x2, uint16_t y2){
  SetWindow(x1,y1,x2,y2); FillWindow(POINT_COLOR);
}

void MRB3971::Clear(uint8_t dir, uint16_t color){
  direction(dir); SetWindow(0,0,lcddev.w-1,lcddev.h-1); FillWindow(color);  
}

void MRB3971::DrawCircle(uint16_t x0,uint16_t y0,uint8_t r){
  int a,b,di;
  a=0; b=r; di=3-(r<<1);
  while(a<=b) {
    DrawPoint(x0-b,y0-a); DrawPoint(x0+b,y0-a); DrawPoint(x0-a,y0+b);
    DrawPoint(x0-b,y0-a); DrawPoint(x0-a,y0-b); DrawPoint(x0+b,y0+a);
    DrawPoint(x0+a,y0-b); DrawPoint(x0+a,y0+b); DrawPoint(x0-b,y0+a);
    a++;
    if(di<0) di += 4*a+6;   
    else {   di += 10+4*(a-b); b--; } 
    DrawPoint(x0+a,y0+b);
  }
} 
void MRB3971::DrawLine(uint16_t x1, uint16_t y1, uint16_t x2, uint16_t y2){
  uint16_t t; 
  int xerr=0,yerr=0,delta_x,delta_y,distance; 
  int incx,incy,uRow,uCol; 
  delta_x=x2-x1;  delta_y=y2-y1; uRow=x1; uCol=y1; 
  if(delta_x>0) incx=1;
  else if(delta_x==0) incx=0;
  else {incx=-1;delta_x=-delta_x;} 
  if(delta_y>0) incy=1; 
  else if(delta_y==0)incy=0;
  else{incy=-1;delta_y=-delta_y;} 
  if( delta_x>delta_y)distance=delta_x;
  else distance=delta_y; 
  for(t=0;t<=distance+1;t++ ) {  
    DrawPoint(uRow,uCol);
    xerr+=delta_x ; yerr+=delta_y ; 
    if(xerr>distance) { xerr-=distance; uRow+=incx; }
    if(yerr>distance) { yerr-=distance; uCol+=incy; }
  }  
}

void MRB3971::DrawRectangle(uint16_t x1, uint16_t y1, uint16_t x2, uint16_t y2){
  DrawLine(x1,y1,x2,y1);  DrawLine(x1,y1,x1,y2);
  DrawLine(x1,y2,x2,y2);  DrawLine(x2,y1,x2,y2);
}  

//-- Paint --------------------------------------------------------------------------------

#define MAXSIZE 256 // Seed Size MAX
#define MINX 0
#define MINY 0
#define MAXX 800 // LCD Size
#define MAXY 480

struct BufStr {
  uint16_t sx;
  uint16_t sy;
};
struct BufStr buff[MAXSIZE]; // Seed Buf
struct BufStr *sIdx, *eIdx;  // Seed Buf Poiner

void MRB3971::pset( uint16_t x, uint16_t y, uint16_t col ){ // Set Dot
  POINT_COLOR = col; DrawPoint(x,y);
}
uint16_t MRB3971::point( uint16_t x, uint16_t y ){ // Get Dot
  return ReadPoint(x,y);
}

void MRB3971::scanLine( uint16_t lx, uint16_t rx, uint16_t y, uint16_t col ){
  while ( lx <= rx ) {
    for ( ; lx <= rx ; lx++ ) if ( point( lx, y ) == col ) break;
    if ( point( lx, y ) != col ) break;
    for ( ; lx <= rx ; lx++ ) if ( point( lx, y ) != col ) break;
    eIdx->sx = lx - 1; eIdx->sy = y;
    if ( ++eIdx == &buff[MAXSIZE] ) eIdx = buff;
  }
}

void MRB3971::paint( uint16_t x, uint16_t y, uint16_t paintCol ){
  uint16_t lx, rx;
  uint16_t ly;
  uint16_t i;
  uint16_t col = point( x, y );
  if ( col == paintCol ) return;

  sIdx = buff;  eIdx = buff + 1;
  sIdx->sx = x; sIdx->sy = y;

  do {
    lx = rx = sIdx->sx; ly = sIdx->sy;
    if ( ++sIdx == &buff[MAXSIZE] ) sIdx = buff;

    if ( point( lx, ly ) != col ) continue;

     while ( rx < MAXX ) { // Scan Right
      if ( point( rx + 1, ly ) != col ) break;
      rx++;
    }

    while ( lx > MINX ) { // Scan Left
      if ( point( lx - 1, ly ) != col ) break;
      lx--;
    }

    for ( i = lx ; i <= rx ; i++ ) pset( i, ly, paintCol );

    if ( ly - 1 >= MINY ) scanLine( lx, rx, ly - 1, col ); // Scan UP Line
    if ( ly + 1 <= MAXY ) scanLine( lx, rx, ly + 1, col ); // Scan Down Line

  } while ( sIdx != eIdx );
}


    
